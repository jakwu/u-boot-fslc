## board/msc/mx6x_nanoRISC/Kconfig
```kconfig
if TARGET_MX6Q_NANORISC

config SYS_BOARD
	default "mx6x_nanoRISC"

config SYS_VENDOR
	default "msc"

config SYS_SOC
	default "mx6"

config SYS_CONFIG_NAME
	default "mx6q_nanoRISC"

endif

if TARGET_MX6DL_NANORISC

config SYS_BOARD
	default "mx6x_nanoRISC"

config SYS_VENDOR
	default "msc"

config SYS_SOC
	default "mx6"

config SYS_CONFIG_NAME
	default "mx6dl_nanoRISC"

endif

if TARGET_MX6S_NANORISC

config SYS_BOARD
	default "mx6x_nanoRISC"

config SYS_VENDOR
	default "msc"

config SYS_SOC
	default "mx6"

config SYS_CONFIG_NAME
	default "mx6s_nanoRISC"

endif
```

## configs/msc-nR-imx6q_143_014_defconfig
```kconfig
CONFIG_SYS_EXTRA_OPTIONS="IMX_CONFIG=board/msc/mx6x_nanoRISC/mx6q_4x_NT5CC256M16CP.cfg,MX6Q,DDR_MB=2048"
CONFIG_ARM=y
CONFIG_TARGET_MX6Q_NANORISC=y
CONFIG_SYS_MALLOC_F=y
CONFIG_SYS_MALLOC_F_LEN=0x400
CONFIG_DM=y
CONFIG_DM_THERMAL=y
```
